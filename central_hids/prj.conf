## prj.conf
```kconfig
#
# Copyright (c) 2019 Nordic Semiconductor ASA
#
# SPDX-License-Identifier: LicenseRef-Nordic-5-Clause
#
CONFIG_NCS_SAMPLES_DEFAULTS=y

CONFIG_BT=y
CONFIG_BT_DEBUG_LOG=y
CONFIG_BT_CENTRAL=y
CONFIG_BT_SMP=y
CONFIG_BT_L2CAP_TX_BUF_COUNT=5
CONFIG_BT_GATT_CLIENT=y
CONFIG_BT_GATT_DM=y
CONFIG_HEAP_MEM_POOL_SIZE=2048
CONFIG_BT_HOGP=y

CONFIG_BT_SCAN=y
CONFIG_BT_SCAN_FILTER_ENABLE=y
CONFIG_BT_SCAN_MANUFACTURER_DATA_CNT=1
CONFIG_BT_EXT_ADV=y
CONFIG_BT_PRIVACY=y

CONFIG_SYSTEM_WORKQUEUE_STACK_SIZE=2048

CONFIG_BT_SETTINGS=y
CONFIG_FLASH=y
CONFIG_FLASH_PAGE_LAYOUT=y
CONFIG_FLASH_MAP=y
CONFIG_NVS=y
CONFIG_SETTINGS=y

CONFIG_DK_LIBRARY=y
CONFIG_GPIO=y
CONFIG_BT_MAX_PAIRED=2
```

## src/main.c
```c
/* main.c - Application main entry point */

/*
 * Copyright (c) 2018 Nordic Semiconductor ASA
 *
 * SPDX-License-Identifier: LicenseRef-Nordic-5-Clause
 */

#include <zephyr/types.h>
#include <stddef.h>
#include <errno.h>
#include <zephyr/kernel.h>
#include <zephyr/sys/printk.h>

#include <zephyr/bluetooth/bluetooth.h>
#include <zephyr/bluetooth/hci.h>
#include <zephyr/bluetooth/conn.h>
#include <zephyr/bluetooth/uuid.h>
#include <zephyr/bluetooth/gatt.h>
#include <bluetooth/gatt_dm.h>
#include <zephyr/sys/byteorder.h>
#include <bluetooth/scan.h>
#include <bluetooth/services/hogp.h>
#include <dk_buttons_and_leds.h>
#include "gap_layer.h"
#include <zephyr/settings/settings.h>
#include "api.h"
#include "gpio_button.h"

#define ENABLE true
#define MANUFACTURER_ID_SIZE 5

extern struct bt_hogp hogp;
extern const struct bt_hogp_init_params hogp_init_params;
extern struct bt_conn_auth_cb conn_auth_callbacks;
extern struct bt_conn_auth_info_cb conn_auth_info_callbacks;

void main(void)
{
	int err;

	printk("Starting Bluetooth Central HIDS example\n");

	hogp_init();

	err = bt_conn_auth_cb_register(&conn_auth_callbacks);
	if (err) {
		printk("failed to register authorization callbacks.\n");
		return 0;
	}

	err = bt_conn_auth_info_cb_register(&conn_auth_info_callbacks);
	if (err) {
		printk("Failed to register authorization info callbacks.\n");
		return 0;
	}

	err = bt_enable(NULL);
	if (err) {
		printk("Bluetooth init failed (err %d)\n", err);
		return;
	}

	printk("Bluetooth initialized\n");

	if (IS_ENABLED(CONFIG_SETTINGS)) {
		settings_load();
	}

	// err = dk_buttons_init(button_handler);
	// if (err) {
	// 	printk("Failed to initialize buttons (err %d)\n", err);
	// 	return 0;
	// }

    uint8_t manufacturer_id [MANUFACTURER_ID_SIZE]={0x58,0x02,0x0f,0x00,0xa5};
    set_filter(&manufacturer_id,MANUFACTURER_ID_SIZE);
    set_scan_timeout_min(1);
    scan_init();
    err = set_scan(ENABLE);

    if (err)
    {
        printk("set_scan failed\n (err %d)\n", err);
        return;
    }
	printk("Scanning successfully started\n");
    button_init();
}
```

## src/api.c
```c
#include "api.h"
struct bt_scan_manufacturer_data manufacturer_id ;

api_error set_scan(bool status)
{
    int err;
    if (status)
    {
        err = bt_scan_start(BT_SCAN_TYPE_SCAN_ACTIVE);
	    if (err)
        {
		    printk("Scanning failed to start (err %d)\n", err);
		    return err;
	    }
        return err;
    }
    err = bt_scan_stop();
    if (err)
    {
		printk("Scanning failed to stop (err %d)\n", err);
		return err;
	}
    return err;
}

void set_filter(uint8_t * manuf_id, uint8_t length)
{
    manufacturer_id.data = manuf_id;
    manufacturer_id.data_len = length;
}

const void * get_manufacturer_id (void)
{
    return &manufacturer_id;
}

uint32_t get_api_version(void)
{
    return API_VERSION;
}

uint32_t get_fw_version(void)
{
    return FW_VERSION;
}

void set_scan_timeout_min(uint32_t timeout)
{
    uint32_t tmp=0;
    tmp = timeout * 100 * 60;
    set_scan_timeout_value_s(tmp);

}
```

## src/api.h
```c
#include <zephyr/types.h>
#include <stdbool.h>
#include <bluetooth/scan.h>
#include "gap_layer.h"

#define FW_VERSION 00000001
#define API_VERSION 00000001

typedef uint32_t api_error;
uint32_t get_api_version(void);
uint32_t get_fw_version(void);
api_error set_scan(bool status);
void set_filter(uint8_t * manuf_id, uint8_t length);
const void * get_manufacturer_id (void);

void set_scan_timeout_min(uint32_t timeout);
```

## src/button.c
```c
// /**
//  * Switch between boot protocol and report protocol mode.
//  */
// #define KEY_BOOTMODE_MASK DK_BTN2_MSK
// /**
//  * Switch CAPSLOCK state.
//  *
//  * @note
//  * For simplicity of the code it works only in boot mode.
//  */
// #define KEY_CAPSLOCK_MASK DK_BTN1_MSK
// /**
//  * Switch CAPSLOCK state with response
//  *
//  * Write CAPSLOCK with response.
//  * Just for testing purposes.
//  * The result should be the same like usine @ref KEY_CAPSLOCK_MASK
//  */
// #define KEY_CAPSLOCK_RSP_MASK DK_BTN3_MSK

// /* Key used to accept or reject passkey value */
// #define KEY_PAIRING_ACCEPT DK_BTN1_MSK
// #define KEY_PAIRING_REJECT DK_BTN2_MSK


// static uint8_t capslock_state;




// static void button_bootmode(void)
// {
// 	if (!bt_hogp_ready_check(&hogp)) {
// 		printk("HID device not ready\n");
// 		return;
// 	}
// 	int err;
// 	enum bt_hids_pm pm = bt_hogp_pm_get(&hogp);
// 	enum bt_hids_pm new_pm = ((pm == BT_HIDS_PM_BOOT) ? BT_HIDS_PM_REPORT : BT_HIDS_PM_BOOT);

// 	printk("Setting protocol mode: %s\n", (new_pm == BT_HIDS_PM_BOOT) ? "BOOT" : "REPORT");
// 	err = bt_hogp_pm_write(&hogp, new_pm);
// 	if (err) {
// 		printk("Cannot change protocol mode (err %d)\n", err);
// 	}
// }

// static void button_capslock(void)
// {
// 	int err;
// 	uint8_t data;

// 	if (!bt_hogp_ready_check(&hogp)) {
// 		printk("HID device not ready\n");
// 		return;
// 	}
// 	if (!hogp.rep_boot.kbd_out) {
// 		printk("HID device does not have Keyboard OUT report\n");
// 		return;
// 	}
// 	if (bt_hogp_pm_get(&hogp) != BT_HIDS_PM_BOOT) {
// 		printk("This function works only in BOOT Report mode\n");
// 		return;
// 	}
// 	capslock_state = capslock_state ? 0 : 1;
// 	data = capslock_state ? 0x02 : 0;
// 	err = bt_hogp_rep_write_wo_rsp(&hogp, hogp.rep_boot.kbd_out,
// 				       &data, sizeof(data),
// 				       hidc_write_cb);

// 	if (err) {
// 		printk("Keyboard data write error (err: %d)\n", err);
// 		return;
// 	}
// 	printk("Caps lock send (val: 0x%x)\n", data);
// }


// static uint8_t capslock_read_cb(struct bt_hogp *hogp,
// 			     struct bt_hogp_rep_info *rep,
// 			     uint8_t err,
// 			     const uint8_t *data)
// {
// 	if (err) {
// 		printk("Capslock read error (err: %u)\n", err);
// 		return BT_GATT_ITER_STOP;
// 	}
// 	if (!data) {
// 		printk("Capslock read - no data\n");
// 		return BT_GATT_ITER_STOP;
// 	}
// 	printk("Received data (size: %u, data[0]: 0x%x)\n",
// 	       bt_hogp_rep_size(rep), data[0]);

// 	return BT_GATT_ITER_STOP;
// }


// static void capslock_write_cb(struct bt_hogp *hogp,
// 			      struct bt_hogp_rep_info *rep,
// 			      uint8_t err)
// {
// 	int ret;

// 	printk("Capslock write result: %u\n", err);

// 	ret = bt_hogp_rep_read(hogp, rep, capslock_read_cb);
// 	if (ret) {
// 		printk("Cannot read capslock value (err: %d)\n", ret);
// 	}
// }


// static void button_capslock_rsp(void)
// {
// 	if (!bt_hogp_ready_check(&hogp)) {
// 		printk("HID device not ready\n");
// 		return;
// 	}
// 	if (!hogp.rep_boot.kbd_out) {
// 		printk("HID device does not have Keyboard OUT report\n");
// 		return;
// 	}
// 	int err;
// 	uint8_t data;

// 	capslock_state = capslock_state ? 0 : 1;
// 	data = capslock_state ? 0x02 : 0;
// 	err = bt_hogp_rep_write(&hogp, hogp.rep_boot.kbd_out, capslock_write_cb,
// 				&data, sizeof(data));
// 	if (err) {
// 		printk("Keyboard data write error (err: %d)\n", err);
// 		return;
// 	}
// 	printk("Caps lock send using write with response (val: 0x%x)\n", data);
// }


// static void num_comp_reply(bool accept)
// {
// 	if (accept) {
// 		bt_conn_auth_passkey_confirm(auth_conn);
// 		printk("Numeric Match, conn %p\n", auth_conn);
// 	} else {
// 		bt_conn_auth_cancel(auth_conn);
// 		printk("Numeric Reject, conn %p\n", auth_conn);
// 	}

// 	bt_conn_unref(auth_conn);
// 	auth_conn = NULL;
// }


// static void button_handler(uint32_t button_state, uint32_t has_changed)
// {
// 	uint32_t button = button_state & has_changed;

// 	if (auth_conn) {
// 		if (button & KEY_PAIRING_ACCEPT) {
// 			num_comp_reply(true);
// 		}

// 		if (button & KEY_PAIRING_REJECT) {
// 			num_comp_reply(false);
// 		}

// 		return;
// 	}

// 	if (button & KEY_BOOTMODE_MASK) {
// 		button_bootmode();
// 	}
// 	if (button & KEY_CAPSLOCK_MASK) {
// 		button_capslock();
// 	}
// 	if (button & KEY_CAPSLOCK_RSP_MASK) {
// 		button_capslock_rsp();
// 	}
// }
```

## src/gap_layer.c
```c
#include <bluetooth/scan.h>
#include <bluetooth/gatt_dm.h>
#include "api.h"
struct bt_conn *default_conn;
struct bt_conn *auth_conn;
extern struct bt_hogp hogp;

uint32_t scan_timeout_value_s = 0;

void set_scan_timeout_value_s(uint32_t value_s)
{
	scan_timeout_value_s = value_s;
}

static void scan_timeout(void)
{
	bt_scan_stop();
	printk ("Scanning timeout\n");
}

static struct bt_le_scan_cb scan_timeout_callback = {
	.timeout = scan_timeout,
};

void scan_filter_match(struct bt_scan_device_info *device_info,
			      struct bt_scan_filter_match *filter_match,
			      bool connectable)
{
	char addr[BT_ADDR_LE_STR_LEN];

	if (!filter_match->manufacturer_data.match) { //||
	    // (filter_match->manufacturer_data.data == NULL)) {

		printk("Invalid device connected\n");

		return;
	}

	bt_addr_le_to_str(device_info->recv_info->addr, addr, sizeof(addr));

	printk("Filters matched on manufaturer id .\nAddress: %s connectable: %s\n",
		// filter_match->manufacturer_data.data,
		addr, connectable ? "yes" : "no");
}

void scan_connecting_error(struct bt_scan_device_info *device_info)
{
	printk("Connecting failed\n");
}

void scan_connecting(struct bt_scan_device_info *device_info,
			    struct bt_conn *conn)
{
	default_conn = bt_conn_ref(conn);
}
/** .. include_startingpoint_scan_rst */
void scan_filter_no_match(struct bt_scan_device_info *device_info,
				 bool connectable)
{
	int err;
	struct bt_conn *conn;
	char addr[BT_ADDR_LE_STR_LEN];

	if (device_info->recv_info->adv_type == BT_GAP_ADV_TYPE_ADV_DIRECT_IND) {
		bt_addr_le_to_str(device_info->recv_info->addr, addr,
				  sizeof(addr));
		printk("Direct advertising received from %s\n", addr);
		bt_scan_stop();

		err = bt_conn_le_create(device_info->recv_info->addr,
					BT_CONN_LE_CREATE_CONN,
					device_info->conn_param, &conn);

		if (!err) {
			default_conn = bt_conn_ref(conn);
			bt_conn_unref(conn);
		}
	}
}
/** .. include_endpoint_scan_rst */
BT_SCAN_CB_INIT(scan_cb, scan_filter_match, scan_filter_no_match,
		scan_connecting_error, scan_connecting);

void scan_init(void)
{
	int err;

	struct bt_le_scan_param scan_param_timeout ={
		.type = BT_LE_SCAN_TYPE_ACTIVE,
		.options = BT_LE_SCAN_OPT_FILTER_DUPLICATE,
		.interval = BT_GAP_SCAN_FAST_INTERVAL,
		.window = BT_GAP_SCAN_FAST_WINDOW,
		.timeout = scan_timeout_value_s,
	};

	struct bt_scan_init_param scan_init = {
		.connect_if_match = 1,
		.scan_param = &scan_param_timeout,
		.conn_param = BT_LE_CONN_PARAM_DEFAULT
	};

	bt_scan_init(&scan_init);
	bt_le_scan_cb_register(&scan_timeout_callback);
	bt_scan_cb_register(&scan_cb);

	err = bt_scan_filter_add(BT_SCAN_FILTER_TYPE_MANUFACTURER_DATA, get_manufacturer_id());
	if (err) {
		printk("Scanning filters cannot be set (err %d)\n", err);

		return;
	}

	err = bt_scan_filter_enable(BT_SCAN_MANUFACTURER_DATA_FILTER, false);
	if (err) {
		printk("Filters cannot be turned on (err %d)\n", err);
	}
}

////////////////////////////////////////

void discovery_completed_cb(struct bt_gatt_dm *dm,
				   void *context)
{
	int err;

	printk("The discovery procedure succeeded\n");

	bt_gatt_dm_data_print(dm);

	err = bt_hogp_handles_assign(dm, &hogp);
	if (err) {
		printk("Could not init HIDS client object, error: %d\n", err);
	}

	err = bt_gatt_dm_data_release(dm);
	if (err) {
		printk("Could not release the discovery data, error "
		       "code: %d\n", err);
	}
}

void discovery_service_not_found_cb(struct bt_conn *conn,
					   void *context)
{
	printk("The service could not be found during the discovery\n");
}

void discovery_error_found_cb(struct bt_conn *conn,
				     int err,
				     void *context)
{
	printk("The discovery procedure failed with %d\n", err);
}

const struct bt_gatt_dm_cb discovery_cb = {
	.completed = discovery_completed_cb,
	.service_not_found = discovery_service_not_found_cb,
	.error_found = discovery_error_found_cb,
};


///////////////////////////////////////
void gatt_discover(struct bt_conn *conn)
{
	int err;

	if (conn != default_conn) {
		return;
	}

	err = bt_gatt_dm_start(conn, BT_UUID_HIDS, &discovery_cb, NULL);
	if (err) {
		printk("could not start the discovery procedure, error "
			"code: %d\n", err);
	}
}

void connected(struct bt_conn *conn, uint8_t conn_err)
{
	int err;
	char addr[BT_ADDR_LE_STR_LEN];

	bt_addr_le_to_str(bt_conn_get_dst(conn), addr, sizeof(addr));

	if (conn_err) {
		printk("Failed to connect to %s (%u)\n", addr, conn_err);
		if (conn == default_conn) {
			bt_conn_unref(default_conn);
			default_conn = NULL;

			/* This demo doesn't require active scan */
			err = bt_scan_start(BT_SCAN_TYPE_SCAN_ACTIVE);
			if (err) {
				printk("Scanning failed to start (err %d)\n",
				       err);
			}
		}

		return;
	}

	printk("Connected: %s\n", addr);

	err = bt_conn_set_security(conn, BT_SECURITY_L2);
	if (err) {
		printk("Failed to set security: %d\n", err);

		gatt_discover(conn);
	}
}

void disconnected(struct bt_conn *conn, uint8_t reason)
{
	char addr[BT_ADDR_LE_STR_LEN];
	int err;

	bt_addr_le_to_str(bt_conn_get_dst(conn), addr, sizeof(addr));

	if (auth_conn) {
		bt_conn_unref(auth_conn);
		auth_conn = NULL;
	}

	printk("Disconnected: %s (reason %u)\n", addr, reason);

	if (bt_hogp_assign_check(&hogp)) {
		printk("HIDS client active - releasing");
		bt_hogp_release(&hogp);
	}

	if (default_conn != conn) {
		return;
	}

	bt_conn_unref(default_conn);
	default_conn = NULL;

	/* This demo doesn't require active scan */
	err = bt_scan_start(BT_SCAN_TYPE_SCAN_ACTIVE);
	if (err) {
		printk("Scanning failed to start (err %d)\n", err);
	}
}

void security_changed(struct bt_conn *conn, bt_security_t level,
			     enum bt_security_err err)
{
	char addr[BT_ADDR_LE_STR_LEN];

	bt_addr_le_to_str(bt_conn_get_dst(conn), addr, sizeof(addr));

	if (!err) {
		printk("Security changed: %s level %u\n", addr, level);
	} else {
		printk("Security failed: %s level %u err %d\n", addr, level,
			err);
	}

	gatt_discover(conn);
}

BT_CONN_CB_DEFINE(conn_callbacks) = {
	.connected        = connected,
	.disconnected     = disconnected,
	.security_changed = security_changed
};

//////////////////////////////////////////////////////////////////////

void auth_cancel(struct bt_conn *conn)
{
	char addr[BT_ADDR_LE_STR_LEN];

	bt_addr_le_to_str(bt_conn_get_dst(conn), addr, sizeof(addr));

	printk("Pairing cancelled: %s\n", addr);
}


void pairing_complete(struct bt_conn *conn, bool bonded)
{
	char addr[BT_ADDR_LE_STR_LEN];

	bt_addr_le_to_str(bt_conn_get_dst(conn), addr, sizeof(addr));

	printk("Pairing completed: %s, bonded: %d\n", addr, bonded);
}


void pairing_failed(struct bt_conn *conn, enum bt_security_err reason)
{
	char addr[BT_ADDR_LE_STR_LEN];

	bt_addr_le_to_str(bt_conn_get_dst(conn), addr, sizeof(addr));

	printk("Pairing failed conn: %s, reason %d\n", addr, reason);
}

struct bt_conn_auth_cb conn_auth_callbacks = {
	.cancel = auth_cancel,
};

struct bt_conn_auth_info_cb conn_auth_info_callbacks = {
	.pairing_complete = pairing_complete,
	.pairing_failed = pairing_failed
};
```

## src/gap_layer.h
```c
#ifndef GAP_LAYER_H
#define GAP_LAYER_H
void scan_init(void);
void set_scan_timeout_value_s(uint32_t value_s);
// int set_filter(uint8_t size, uint8_t *manufacturer_id);
#endif
```

## src/gpio_button.c
```c
#include "gpio_button.h"
extern uint32_t irq_status;
void button_pressed(const struct device *dev, struct gpio_callback *cb, uint32_t pins)
{
    gpio_pin_toggle_dt(&led);
	printk("irq-status: %d\n",irq_status);
    irq_status = 0x00;
}

int button_init(void)
{
	int err;
	if (!device_is_ready(led.port)) {
		return GPIO_DEVICE_IS_NOT_READY;
	}
	if (!device_is_ready(button.port)) {
		return GPIO_DEVICE_IS_NOT_READY;
	}
	err = gpio_pin_configure_dt(&led, GPIO_OUTPUT_ACTIVE);
	if (err < 0) {
		return GPIO_PIN_CONFIG_DT_FAILED;
	}
	err = gpio_pin_configure_dt(&button, GPIO_INPUT);
	if (err < 0) {
		return GPIO_PIN_CONFIG_DT_FAILED;
	}
	err = gpio_pin_interrupt_configure_dt(&button, GPIO_INT_EDGE_TO_ACTIVE );
    gpio_init_callback(&button_cb_data, button_pressed, BIT(button.pin));
	gpio_add_callback(button.port, &button_cb_data);
	return 0;
}
```

## src/hogp_layer.c
```c
#include <bluetooth/services/hogp.h>
uint32_t irq_status = 0x00;
struct bt_hogp hogp;

void hids_on_ready(struct k_work *work);
K_WORK_DEFINE(hids_ready_work, hids_on_ready);

uint8_t hogp_notify_cb(struct bt_hogp *hogp,
			     struct bt_hogp_rep_info *rep,
			     uint8_t err,
			     const uint8_t *data)
{
	uint8_t size = bt_hogp_rep_size(rep);
	uint8_t i;

	if (!data) {
		return BT_GATT_ITER_STOP;
	}
	printk("Notification, id: %u, size: %u, data:",
	       bt_hogp_rep_id(rep),
	       size);
	for (i = 0; i < size; ++i) {
		printk(" 0x%x", data[i]);
	}
	printk("\n");
	return BT_GATT_ITER_CONTINUE;
}

uint8_t hogp_boot_mouse_report(struct bt_hogp *hogp,
				     struct bt_hogp_rep_info *rep,
				     uint8_t err,
				     const uint8_t *data)
{
	uint8_t size = bt_hogp_rep_size(rep);
	uint8_t i;

	if (!data) {
		return BT_GATT_ITER_STOP;
	}
	printk("Notification, mouse boot, size: %u, data:", size);
	for (i = 0; i < size; ++i) {
		printk(" 0x%x", data[i]);
	}
	printk("\n");
	return BT_GATT_ITER_CONTINUE;
}

uint8_t hogp_boot_kbd_report(struct bt_hogp *hogp,
				   struct bt_hogp_rep_info *rep,
				   uint8_t err,
				   const uint8_t *data)
{
	uint8_t size = bt_hogp_rep_size(rep);
	uint8_t i;

	if (!data) {
		return BT_GATT_ITER_STOP;
	}
	printk("Notification, keyboard boot, size: %u, data:", size);
	for (i = 0; i < size; ++i) {
		printk(" 0x%x", data[i]);
	}
	printk("\n");
	return BT_GATT_ITER_CONTINUE;
}

void hogp_ready_cb(struct bt_hogp *hogp)
{
	k_work_submit(&hids_ready_work);
}

void hids_on_ready(struct k_work *work)
{
	int err;
	struct bt_hogp_rep_info *rep = NULL;

	printk("HIDS is ready to work\n");

	while (NULL != (rep = bt_hogp_rep_next(&hogp, rep))) {
		if (bt_hogp_rep_type(rep) ==
		    BT_HIDS_REPORT_TYPE_INPUT) {
			printk("Subscribe to report id: %u\n",
			       bt_hogp_rep_id(rep));
			err = bt_hogp_rep_subscribe(&hogp, rep,
							   hogp_notify_cb);
			if (err) {
				printk("Subscribe error (%d)\n", err);
			}
		}
	}
	if (hogp.rep_boot.kbd_inp) {
		printk("Subscribe to boot keyboard report\n");
		err = bt_hogp_rep_subscribe(&hogp,
						   hogp.rep_boot.kbd_inp,
						   hogp_boot_kbd_report);
		if (err) {
			printk("Subscribe error (%d)\n", err);
		}
	}
	if (hogp.rep_boot.mouse_inp) {
		printk("Subscribe to boot mouse report\n");
		err = bt_hogp_rep_subscribe(&hogp,
						   hogp.rep_boot.mouse_inp,
						   hogp_boot_mouse_report);
		if (err) {
			printk("Subscribe error (%d)\n", err);
		}
	}
}

void hogp_prep_fail_cb(struct bt_hogp *hogp, int err)
{
	printk("ERROR: HIDS client preparation failed!\n");
}

void hogp_pm_update_cb(struct bt_hogp *hogp)
{
	printk("Protocol mode updated: %s\n",
	      bt_hogp_pm_get(hogp) == BT_HIDS_PM_BOOT ?
	      "BOOT" : "REPORT");
}

/* HIDS client initialization parameters */
const struct bt_hogp_init_params hogp_init_params = {
	.ready_cb      = hogp_ready_cb,
	.prep_error_cb = hogp_prep_fail_cb,
	.pm_update_cb  = hogp_pm_update_cb
};

void hidc_write_cb(struct bt_hogp *hidc,
			  struct bt_hogp_rep_info *rep,
			  uint8_t err)
{
	printk("Caps lock sent\n");
}

void hogp_init(void)
{
	bt_hogp_init(&hogp, &hogp_init_params);
}
```

## src/hogp_layer.h
```c
void hogp_init(void);
```
