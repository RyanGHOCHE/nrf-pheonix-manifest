## CMakeLists.txt
```
#-------------------------------------------------------------------------------
# Zephyr Example Application
#
# Copyright (c) 2021 Nordic Semiconductor ASA
# SPDX-License-Identifier: Apache-2.0

cmake_minimum_required(VERSION 3.20.0)

find_package(Zephyr REQUIRED HINTS $ENV{ZEPHYR_BASE})
project(phoenix LANGUAGES C VERSION 1.0.0)
FILE(GLOB app_sources src/*.c)
# configure_file(app_version.h.in ${CMAKE_BINARY_DIR}/app/include/app_version.h)
# target_include_directories(app PRIVATE ${CMAKE_BINARY_DIR}/app/inc src)
target_include_directories(app PRIVATE inc)
target_sources(app PRIVATE ${app_sources})
```

## prj.conf
```kconfig
#
# Copyright (c) 2019 Nordic Semiconductor ASA
#
# SPDX-License-Identifier: LicenseRef-Nordic-5-Clause
#
CONFIG_NCS_SAMPLES_DEFAULTS=y

CONFIG_BT=y
CONFIG_BT_DEBUG_LOG=y
CONFIG_BT_CENTRAL=y
CONFIG_BT_SMP=y
CONFIG_BT_L2CAP_TX_BUF_COUNT=5
CONFIG_BT_GATT_CLIENT=y
CONFIG_BT_GATT_DM=y
CONFIG_BT_EXT_ADV=y
CONFIG_HEAP_MEM_POOL_SIZE=2048
CONFIG_BT_HOGP=y

CONFIG_BT_SCAN=y
CONFIG_BT_SCAN_FILTER_ENABLE=y
CONFIG_BT_SCAN_MANUFACTURER_DATA_CNT=1
CONFIG_BT_PRIVACY=y

CONFIG_SYSTEM_WORKQUEUE_STACK_SIZE=2048
CONFIG_BT_SETTINGS=y
CONFIG_FLASH=y
CONFIG_FLASH_PAGE_LAYOUT=y
CONFIG_FLASH_MAP=y
CONFIG_NVS=y
CONFIG_SETTINGS=y

CONFIG_DK_LIBRARY=y
CONFIG_BT_MAX_PAIRED=2
```

## src/main.c
```c
#include <zephyr/bluetooth/bluetooth.h>
#include <zephyr/settings/settings.h>
#include <zephyr/kernel.h>
#include "api.h"
#include "gpio_button.h"

#define SLEEP_TIME_MS   10*60*1000
#define SIZE 5

void main(void)
{
	int err;
	err = bt_enable(NULL);
	if (err) {
		printk("Bluetooth init failed (err %d)\n", err);
		return 0;
	}

	printk("Bluetooth initialized\n");

	if (IS_ENABLED(CONFIG_SETTINGS)) {
		settings_load();
	}

    err = button_init();
    if (err)
    {
        printk("Button init failed (err %d)\n", err);
        return;
    }
    printk("Debug button init\n");

	printk ("FW_VERSION=%x\n",get_fw_version());
	printk ("API_VERSION=%x\n",get_api_version());

	uint8_t * manufacturer_id [5] = {0x58,0x02,0x0f,0x00,0xa5};
	err = set_filter(5,manufacturer_id);
	if (err)
	{
		printk("Set filter failed (err %d)\n", err);
	}

	while (1) {
        k_msleep(SLEEP_TIME_MS);
	}

}
```

## inc/api.h
```c
//------------------------------------------------------------------------------
// Copyright (c) 2018 Devialet. All rights reserved.
//
// WARNING: This file is auto-generated!
//------------------------------------------------------------------------------

#ifndef _API_H_
#define _API_H_

#include <stdint.h>

#define API_VERSION 0x03060000
#define FW_VERSION 0x00000001
#define API_HEADER 0xf0
#define ARRAY_MAX_SIZE 64
#define PROTOCOL_ERROR_CRC 1
#define PROTOCOL_ERROR_UNKNOWN_FCT 2
#define PROTOCOL_ERROR_SIZE 3
#define API_ERROR 1

typedef uint32_t api_error_t;

/**
 * Get API version.
 * @return API version in 0xMMmmpppp format.
 */
uint32_t get_api_version(void);

/**
 * Get firmware version.
 * @return Firmware version in 0xMMmmpppp f#define API_VERSION 0x03060000ormat.
 */
uint32_t get_fw_version(void);

api_error_t set_filter (uint8_t size, uint8_t * manufacturer_id);
/**
 * Load data into an ASP memory
 * @param offset Offset in word in selected memory
 * @param length Data length in word size
 * @param data Array to load into the memory
 * @return Number of words written
 */
static int32_t load_asp_memory(uint32_t offset, uint8_t length, int32_t *data);


#endif /* _API_H_ */
```

## inc/ble_api.h
```c
#ifndef BLE_API_H
#define BLE_API_H

#include "scan_api.h"

void set_filter (uint8_t *manufacturer_id, uint8_t size);
int scan_start(void);
int scan_stop(void);
uint8_t get_remote_volume(void);
uint8_t get_remote_status(void);
#endif
```

## inc/hogp_api.h
```c
#ifndef HOGP_API_H
#define HOGP_API_H

#include <zephyr/kernel.h>
#include <bluetooth/services/hogp.h>

struct bt_hogp * get_hogp(void);
void hogp_init(void);
uint8_t notification_cb(uint8_t rep);

uint8_t hogp_notify_cb(struct bt_hogp *hogp,
			     struct bt_hogp_rep_info *rep,
			     uint8_t err,
			     const uint8_t *data);

void hogp_ready_cb(struct bt_hogp *hogp);

void hids_on_ready(struct k_work *work);

void hogp_prep_fail_cb(struct bt_hogp *hogp, int err);

void hidc_write_cb(struct bt_hogp *hidc,
			  struct bt_hogp_rep_info *rep,
			  uint8_t err);
#endif
```

## inc/scan_api.h
```c
#ifndef SCAN_API_H
#define SCAN_API_H
#include <bluetooth/scan.h>
#include <zephyr/bluetooth/conn.h>
#include <zephyr/bluetooth/gatt.h>
#include "hogp_api.h"
#define ERR -1

int set_manufacturer_data (struct bt_scan_manufacturer_data usr_manufacturer_data);

struct bt_scan_manufacturer_data get_manufacturer_data ();

/**********************************************************/

void scan_filter_match(struct bt_scan_device_info *device_info,
			      struct bt_scan_filter_match *filter_match,
			      bool connectable);

void scan_connecting_error(struct bt_scan_device_info *device_info);

void scan_connecting(struct bt_scan_device_info *device_info,
			    struct bt_conn *conn);

void scan_filter_no_match(struct bt_scan_device_info *device_info,
				 bool connectable);

int scan_init(void);

/***********************/

void discovery_completed_cb(struct bt_gatt_dm *dm,
				   void *context);

void discovery_service_not_found_cb(struct bt_conn *conn,
					   void *context);

void discovery_error_found_cb(struct bt_conn *conn,
				     int err,
				     void *context);

void gatt_discover(struct bt_conn *conn);

static const struct bt_gatt_dm_cb discovery_cb = {
	.completed = discovery_completed_cb,
	.service_not_found = discovery_service_not_found_cb,
	.error_found = discovery_error_found_cb,
};

void connected(struct bt_conn *conn, uint8_t conn_err);

void disconnected(struct bt_conn *conn, uint8_t reason);

void security_changed(struct bt_conn *conn, bt_security_t level,
			     enum bt_security_err err);
#endif
```

## src/api.c
```c
#include "api.h"
#include "scan_api.h"

uint32_t get_api_version(void)
{
    return API_VERSION;
}

uint32_t get_fw_version(void)
{
    return FW_VERSION;
}

api_error_t set_filter(uint8_t size, uint8_t *manufacturer_id)
{
    struct bt_scan_manufacturer_data manufacturer_data;
	manufacturer_data.data=manufacturer_id;
    manufacturer_data.data_len = size;
	return set_manufacturer_data(manufacturer_data);
}

// api_error_t set_scan(bool state)
// {
//     int err;
//     if (state == 1)
//     {
//         err = bt_scan_start(BT_SCAN_TYPE_SCAN_PASSIVE);
// 	    if (err) {
// 		    printk("Scanning failed to start (err %d)\n", err);
// 		    return err;
// 	    }
//         printk("Scanning successfully started\n");
// 	    return 0;
//     }
//     else
//     {
//         err = bt_scan_stop();
// 	    if (err) {
// 		    printk("Scanning failed to start (err %d)\n", err);
// 		    return err;
// 	    }
//         printk("Scanning successfully stoped\n");
// 	    return 0;
//     }
// }
```

## src/ble_api.c
```c
#include "ble_api.h"

void set_filter (uint8_t *manufacturer_id, uint8_t size)
{
	struct bt_scan_manufacturer_data manufacturer_data;
	manufacturer_data.data=manufacturer_id;
    manufacturer_data.data_len = size;
	set_manufacturer_data(manufacturer_data);
}

int scan_start(void)
{
    int err;
    err = bt_scan_start(BT_SCAN_TYPE_SCAN_PASSIVE);
	if (err) {
		printk("Scanning failed to start (err %d)\n", err);
		return err;
	}
	printk("Scanning successfully started\n");
	return 0;
}

int scan_stop(void)
{
    int err;
    err = bt_scan_stop();
	if (err) {
		printk("Scanning failed to start (err %d)\n", err);
		return err;
	}
	return 0;
}

uint8_t get_remote_volume(void)
{
    return notification_cb(4);
}

uint8_t get_remote_status(void)
{
    return notification_cb(7);
}
```

## src/gpio_button.c
```c
#include "gpio_button.h"

void button_pressed(const struct device *dev, struct gpio_callback *cb, uint32_t pins)
{
    gpio_pin_toggle_dt(&led);
}

int button_init(void)
{
	int err;
	if (!device_is_ready(led.port)) {
		return GPIO_DEVICE_IS_NOT_READY;
	}
	if (!device_is_ready(button.port)) {
		return GPIO_DEVICE_IS_NOT_READY;
	}
	err = gpio_pin_configure_dt(&led, GPIO_OUTPUT_ACTIVE);
	if (err < 0) {
		return GPIO_PIN_CONFIG_DT_FAILED;
	}
	err = gpio_pin_configure_dt(&button, GPIO_INPUT);
	if (err < 0) {
		return GPIO_PIN_CONFIG_DT_FAILED;
	}
	err = gpio_pin_interrupt_configure_dt(&button, GPIO_INT_EDGE_TO_ACTIVE );
    gpio_init_callback(&button_cb_data, button_pressed, BIT(button.pin));
	gpio_add_callback(button.port, &button_cb_data);
	return 0;
}
```

## src/hogp_api.c
```c
#include "hogp_api.h"

static struct bt_hogp hogp;
static uint8_t remote_volume=0;
static uint8_t remote_status=0;
static uint8_t button_count=0;

K_WORK_DEFINE(hids_ready_work, hids_on_ready);

static const struct bt_hogp_init_params hogp_init_params = {
	.ready_cb      = hogp_ready_cb,
	.prep_error_cb = hogp_prep_fail_cb,
};

uint8_t notification_cb(uint8_t rep)
{
	if (rep == 4)
	{
		return remote_volume;
	}

	if (rep == 7)
	{
		return remote_status;
	}
	else
	{
		printk("Report id %d not supported",rep);
		return 1;
	}
}

uint8_t hogp_notify_cb(struct bt_hogp *hogp,
			     struct bt_hogp_rep_info *rep,
			     uint8_t err,
			     const uint8_t *data)
{
	// uint8_t size = bt_hogp_rep_size(rep);
	// uint8_t i;

	if (!data) {
		return BT_GATT_ITER_STOP;
	}

	if (bt_hogp_rep_id(rep)==4)
	{
		remote_volume=data[0];
	}
	if (bt_hogp_rep_id(rep)==7)
	{
		button_count = button_count + 1;
		if (button_count == 1)
		{
			remote_status=data[0];
		}
		if (button_count == 2)
		{
			button_count = 0;
		}
	}

	return BT_GATT_ITER_CONTINUE;
}

void hogp_ready_cb(struct bt_hogp *hogp)
{
	k_work_submit(&hids_ready_work);
}

void hids_on_ready(struct k_work *work)
{
	int err;
	struct bt_hogp_rep_info *rep = NULL;

	printk("HIDS is ready to work\n");

	while (NULL != (rep = bt_hogp_rep_next(&hogp, rep)))
	{
		if (bt_hogp_rep_type(rep) ==
		    BT_HIDS_REPORT_TYPE_INPUT)
		{
			printk("Subscribe to report id: %u\n",
			       bt_hogp_rep_id(rep));
			err = bt_hogp_rep_subscribe(&hogp, rep,
							   hogp_notify_cb);
			if (err)
			{
				printk("Subscribe error (%d)\n", err);
			}
		}
	}
}

void hogp_prep_fail_cb(struct bt_hogp *hogp, int err)
{
	printk("ERROR: HIDS client preparation failed!\n");
}

void hidc_write_cb(struct bt_hogp *hidc,
			  struct bt_hogp_rep_info *rep,
			  uint8_t err)
{
	printk("Volume sent\n");
}
void hogp_init(void)
{
	bt_hogp_init(&hogp, &hogp_init_params);
}

struct bt_hogp * get_hogp(void)
{
	return &hogp;
}
```

## src/scan_api.c
```c
#include "scan_api.h"

struct bt_scan_manufacturer_data manufacturer_data; //app api
struct bt_conn *auth_conn;
struct bt_conn *default_conn; //scan

uint8_t set_manufacturer_data (struct bt_scan_manufacturer_data usr_manufacturer_data)
{
	manufacturer_data = usr_manufacturer_data;
	return (manufacturer_data.data == NULL) ? ERR: 0;
}

struct bt_scan_manufacturer_data get_manufacturer_data ()
{
	return manufacturer_data;
}

void scan_filter_match(struct bt_scan_device_info *device_info,
			      struct bt_scan_filter_match *filter_match,
			      bool connectable)
{
    static char addr[BT_ADDR_LE_STR_LEN];
	if (!filter_match->manufacturer_data.match) {

		printk("Invalid device connected\n");

		return;
	}
	// if (device_info->recv_info->rssi < rssi_tresh)
	// {
	// 	printk("RSSI signal low\n");
	// 	return;
	// }
	bt_addr_le_to_str(device_info->recv_info->addr, addr, sizeof(addr));
    printk("Address:%s\n",addr);
}

void scan_connecting_error(struct bt_scan_device_info *device_info)
{
	printk("Connecting failed\n");
}

void scan_connecting(struct bt_scan_device_info *device_info,
			    struct bt_conn *conn)
{
	default_conn = bt_conn_ref(conn);
}
/** .. include_startingpoint_scan_rst */
void scan_filter_no_match(struct bt_scan_device_info *device_info,
				 bool connectable)
{
	int err;
	struct bt_conn *conn;
	char addr[BT_ADDR_LE_STR_LEN];
	if (device_info->recv_info->adv_type == BT_GAP_ADV_TYPE_ADV_DIRECT_IND) {
		bt_addr_le_to_str(device_info->recv_info->addr, addr,
				  sizeof(addr));
		printk("Direct advertising received from %s\n", addr);
		bt_scan_stop();

		err = bt_conn_le_create(device_info->recv_info->addr,
					BT_CONN_LE_CREATE_CONN,
					device_info->conn_param, &conn);

		if (!err) {
			default_conn = bt_conn_ref(conn);
			bt_conn_unref(conn);
		}
	}
}

/** .. include_endpoint_scan_rst */
BT_SCAN_CB_INIT(scan_cb, scan_filter_match, scan_filter_no_match,
		scan_connecting_error, scan_connecting);

int scan_init(void)
{
	int err;

	struct bt_scan_init_param scan_init = {
		.connect_if_match = 1,
		.scan_param = NULL,
		.conn_param = BT_LE_CONN_PARAM_DEFAULT
	};

	bt_scan_init(&scan_init);
	bt_scan_cb_register(&scan_cb);

	err = bt_scan_filter_add(BT_SCAN_FILTER_TYPE_MANUFACTURER_DATA, &manufacturer_data);
	if (err) {
		printk("Scanning filters cannot be set (err %d)\n", err);
		return err;
	}

	err = bt_scan_filter_enable(BT_SCAN_MANUFACTURER_DATA_FILTER, false);
	if (err) {
		printk("Filters cannot be turned on (err %d)\n", err);
		return err;
	}
	return 0;
}

/**************************/

void discovery_completed_cb(struct bt_gatt_dm *dm,
				   void *context)
{
	int err;

	printk("The discovery procedure succeeded\n");

	bt_gatt_dm_data_print(dm);

	err = bt_hogp_handles_assign(dm, get_hogp());
	if (err) {
		printk("Could not init HIDS client object, error: %d\n", err);
	}

	err = bt_gatt_dm_data_release(dm);
	if (err) {
		printk("Could not release the discovery data, error "
		       "code: %d\n", err);
	}
}

void discovery_service_not_found_cb(struct bt_conn *conn,
					   void *context)
{
	printk("The service could not be found during the discovery\n");
}

void discovery_error_found_cb(struct bt_conn *conn,
				     int err,
				     void *context)
{
	printk("The discovery procedure failed with %d\n", err);
}

void gatt_discover(struct bt_conn *conn)
{
	int err;

	if (conn != default_conn) {
		return;
	}

	err = bt_gatt_dm_start(conn, BT_UUID_HIDS, &discovery_cb, NULL);
	if (err) {
		printk("could not start the discovery procedure, error "
			"code: %d\n", err);
	}
}

/***************/

void connected(struct bt_conn *conn, uint8_t conn_err)
{
	int err;
	char addr[BT_ADDR_LE_STR_LEN];

	bt_addr_le_to_str(bt_conn_get_dst(conn), addr, sizeof(addr));

	if (conn_err) {
		printk("Failed to connect to %s (%u)\n", addr, conn_err);
		if (conn == default_conn) {
			bt_conn_unref(default_conn);
			default_conn = NULL;

			/* This demo doesn't require active scan */
			err = bt_scan_start(BT_SCAN_TYPE_SCAN_PASSIVE);
			if (err) {
				printk("Scanning failed to start (err %d)\n",
				       err);
			}
		}

		return;
	}

	printk("Connected: %s\n", addr);

	err = bt_conn_set_security(conn, BT_SECURITY_L2);
	if (err) {
		printk("Failed to set security: %d\n", err);

		gatt_discover(conn);
	}
}

void disconnected(struct bt_conn *conn, uint8_t reason)
{
	char addr[BT_ADDR_LE_STR_LEN];
	int err;

	bt_addr_le_to_str(bt_conn_get_dst(conn), addr, sizeof(addr));

	if (auth_conn) {
		bt_conn_unref(auth_conn);
		auth_conn = NULL;
	}

	printk("Disconnected: %s (reason %u)\n", addr, reason);

	if (bt_hogp_assign_check(get_hogp())) {
		printk("HIDS client active - releasing");
		bt_hogp_release(get_hogp());
	}

	if (default_conn != conn) {
		return;
	}

	bt_conn_unref(default_conn);
	default_conn = NULL;

	/* This demo doesn't require active scan */
	err = bt_scan_start(BT_SCAN_TYPE_SCAN_PASSIVE);
	if (err) {
		printk("Scanning failed to start (err %d)\n", err);
	}
}

void security_changed(struct bt_conn *conn, bt_security_t level,
			     enum bt_security_err err)
{
	char addr[BT_ADDR_LE_STR_LEN];

	bt_addr_le_to_str(bt_conn_get_dst(conn), addr, sizeof(addr));

	if (!err) {
		printk("Security changed: %s level %u\n", addr, level);
	} else {
		printk("Security failed: %s level %u err %d\n", addr, level,
			err);
	}

	gatt_discover(conn);
}

BT_CONN_CB_DEFINE(conn_callbacks) = {
	.connected        = connected,
	.disconnected     = disconnected,
	.security_changed = security_changed
};
```

## src/toto.c
```c
#include <zephyr/bluetooth/bluetooth.h>
#include <zephyr/settings/settings.h>
#include <dk_buttons_and_leds.h>

#include "hogp_api.h"
#include "ble_api.h"

#define KEY_BTN1_MASK DK_BTN1_MSK
#define SIZE 5

static uint8_t volume_state;

static void button_test(void)
{
	int err;
	struct bt_hogp_rep_info *rep = NULL;
	uint8_t data [2];

	if (!bt_hogp_ready_check(get_hogp())) {
		printk("HID device not ready\n");
		return;
	}

	volume_state = volume_state ? 0 : 1;
	data[0] = volume_state ? 0x32 : 0x25;
	data[1]=0x01;

	while (NULL != (rep = bt_hogp_rep_next(get_hogp(), rep)))
	{
		if (bt_hogp_rep_type(rep) ==
		    BT_HIDS_REPORT_TYPE_OUTPUT) {
			printk("Subscribe to output report id: %u\n",
			       bt_hogp_rep_id(rep));
			err = bt_hogp_rep_write_wo_rsp(get_hogp(),rep,
				       &data, sizeof(data),
				       hidc_write_cb);

			if (err) {
				printk("peripheral device data write error (err: %d)\n", err);
				return;
			}
	}
	}
	printk("Volume send (val: 0x%x)\n", data[0]);
}

static void button_handler(uint32_t button_state, uint32_t has_changed)
{
	uint32_t button = button_state & has_changed;

	if (button & KEY_BTN1_MASK) {
		button_test();
	}
}

int main1(void)
{
	uint8_t data[SIZE]={0x58,0x02,0x0F,0x00,0xA5};
	set_filter(data,SIZE);
	int err;

	hogp_init();

	err = bt_enable(NULL);
	if (err) {
		printk("Bluetooth init failed (err %d)\n", err);
		return 0;
	}

	printk("Bluetooth initialized\n");

	if (IS_ENABLED(CONFIG_SETTINGS)) {
		settings_load();
	}

	err = dk_buttons_init(button_handler);
	if (err)
	{
		printk("Failed to initialize buttons (err %d)\n", err);
		return 0;
	}

	scan_init();
	err = scan_start();
	if (err)
	{
		printk("Failed to start bluetooth scanning (err %d)\n", err);
		return 0;
	}

	while (true)
	{
		printk("APP REMOTE VOLUME = %u\n",get_remote_volume());
		printk("APP REMOTE STATUS = %x\n",get_remote_status());
		k_msleep(1000);
	}
	return 0;
}
```
